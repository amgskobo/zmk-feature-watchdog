## Kconfig
```kconfig
config ZMK_WATCHDOG_NATIVE_INPUT_FIXTURE
    bool "Watchdog owner native input fixture"
    depends on BOARD_NATIVE_SIM && KSCAN && DT_HAS_AMGSKOBO_WATCHDOG_TEST_KSCAN_ENABLED
    depends on ZMK_WATCHDOG_NATIVE_SANITIZER_FIXTURE
    help
      Synthetic input source for this owner's native tests only. Uses public
      Kscan callbacks and cannot be enabled on production boards.

config ZMK_WATCHDOG_NATIVE_SANITIZER_FIXTURE
    bool "Watchdog owner native sanitizer link fixture"
    depends on BOARD_NATIVE_SIM && ASAN
    help
      Select the strict sanitizer runtime at native_sim's final host link for
      the owner's native scenarios and original-core expected-failure controls.
      This test profile cannot be enabled on production boards.

config ZMK_WATCHDOG
    bool "Enable firmware watchdog incident logging"
    select SETTINGS
    select CRC
    select ZMK_LOW_PRIORITY_WORK_QUEUE
    select HWINFO

# Modules are parsed before Zephyr's task_wdt defaults. Keep its finite
# fallback timer path: this core overflows its absolute timeout sentinel at
# task_wdt_init(NULL) with fallback off. Matching the monitor's deadline
# avoids the unused 100-ms background wake without changing global overrides.
config TASK_WDT_MIN_TIMEOUT
    depends on TASK_WDT && TASK_WDT_HW_FALLBACK
    default ZMK_WATCHDOG_FREEZE_TIMEOUT_MS if ZMK_WATCHDOG_FREEZE_DETECT && ZMK_WATCHDOG_FREEZE_TIMEOUT_MS <= 10000
    default 10000 if ZMK_WATCHDOG_FREEZE_DETECT

if ZMK_WATCHDOG

config ZMK_WATCHDOG_MAX_INCIDENTS
    int "Maximum number of stored incidents (flash slot cap, per half)"
    default 16
    range 1 65535
    help
      Once this many incidents are stored, a new one is dropped and counted
      without writing Flash until incidents are deleted, unless
      ZMK_WATCHDOG_OVERWRITE_OLDEST is enabled.
      RAM uses an 8-byte index per slot and one shared 340-byte read buffer;
      complete history bodies stay in settings. Retrieval may block on
      settings I/O; count/status remain RAM-only.

config ZMK_WATCHDOG_OVERWRITE_OLDEST
    bool "Overwrite the oldest stored incident when the store is full"
    help
      A new incident replaces the one with the lowest incident ordinal, so
      the newest ZMK_WATCHDOG_MAX_INCIDENTS incidents are kept and recording
      never stops. A failed write keeps the old incident. Incident IDs keep
      increasing; the replaced ID is gone. An incident earlier than
      ZMK_WATCHDOG_OVERWRITE_MIN_UPTIME_S after boot is still dropped when
      the store is full. A positive minimum uptime suppresses earlier
      crash-loop replacements; zero permits every incident to replace one.
      This is not a Flash wear guarantee.

config ZMK_WATCHDOG_OVERWRITE_MIN_UPTIME_S
    int "Smallest uptime (s) of an incident that may overwrite the oldest one"
    depends on ZMK_WATCHDOG_OVERWRITE_OLDEST
    default 10
    range 0 3600
    help
      Incident-age gate for replacing a record in a full store. This is not
      a global write-rate limit: free slots and multiple qualifying appends
      are separate cases. 0 permits replacement for every incident.

config ZMK_WATCHDOG_PENDING_CONVERT_DELAY_MS
    int "Initial delay and retry interval for pending conversion (ms)"
    default 100
    range 0 60000
    help
      A retained incident is written to Flash only after this module's
      settings commit has run (settings_load() is called from main(), after
      every SYS_INIT level). Until then the conversion keeps the retained
      record and retries on the low-priority work queue at this interval;
      elapsed time alone never permits a write.

config ZMK_WATCHDOG_STUDIO_RPC
    bool "Expose watchdog incident log via custom Studio RPC"
    depends on ZMK_STUDIO
    select ZMK_WATCHDOG_PROTOBUF

config ZMK_WATCHDOG_STUDIO_RPC_UNSECURED
    bool "Allow the watchdog Studio RPC while the device is locked"
    depends on ZMK_WATCHDOG_STUDIO_RPC
    help
      By default the RPC and its notifications require an unlocked device
      (&studio_unlock). Enable this for a keyboard that may be too broken to
      type the unlock combo. The incident log can contain register and
      application data; consider who can connect to the transport.

# Hidden: a split peripheral needs nanopb for the relay without ZMK_STUDIO,
# which is what normally selects it.
config ZMK_WATCHDOG_PROTOBUF
    bool
    select NANOPB
    imply NANOPB_NO_ERRMSG
    imply NANOPB_WITHOUT_64BIT
    imply NANOPB_NO_ENCODE_SIZE_CHECK

config ZMK_WATCHDOG_SPLIT_RELAY
    bool "Relay watchdog Studio RPC to split peripherals"
    default y if ZMK_SPLIT
    depends on ZMK_SPLIT_RELAY_EVENT
    # The central relays on behalf of its own Studio RPC; without it there
    # is nothing to relay.
    depends on !ZMK_SPLIT_ROLE_CENTRAL || ZMK_WATCHDOG_STUDIO_RPC
    select ZMK_WATCHDOG_PROTOBUF
    help
      Enable on both halves. A GetStatus/ListIncidents/DeleteIncidents
      request with a nonzero `source` is relayed to the peripherals, and the
      answer arrives as a PeripheralResponse Studio notification, under the
      same lock rule as the RPC itself. A page is streamed one incident per
      relay event, so the framework default
      CONFIG_ZMK_SPLIT_RELAY_EVENT_DATA_LEN is enough.

      The relay transport broadcasts to every connected peripheral and gives
      no delivery guarantee. Responses carry their source and request ID,
      and the client must time out on a peripheral that never answers.
      Verify split traffic and reconnects on the real keyboard.

config ZMK_WATCHDOG_SPLIT_RELAY_TEST
    bool "Enable watchdog split relay self-test (test builds only)"
    depends on ZMK_WATCHDOG_SPLIT_RELAY
    help
      Adds a boot-time self-test that bypasses the real split transport and
      prints PASS lines. On a peripheral it executes relayed requests against
      the local store and checks the relay responses; on a central it checks
      that dispatch returns distinct, nonzero deferred request IDs.

config ZMK_WATCHDOG_FREEZE_DETECT
    bool "Detect long thread/work-queue freezes via Zephyr's task watchdog"
    default y
    select TASK_WDT
    help
      Each monitored work queue gets a task_wdt channel, fed twice per
      timeout by work running on that queue. If the queue is blocked longer
      than CONFIG_ZMK_WATCHDOG_FREEZE_TIMEOUT_MS, the channel records a
      FREEZE incident and reboots. Monitoring is armed during APPLICATION
      initialization and is software-only: a stop of the whole CPU or of its
      interrupts is not detected. The Task WDT background interval defaults
      to this deadline, capped at Zephyr's 10000-ms limit. Explicit global
      settings still win; this module passes NULL and arms no hardware WDT.

if ZMK_WATCHDOG_FREEZE_DETECT

config ZMK_WATCHDOG_FREEZE_TRACE
    bool "Capture a bounded Cortex-M3/M4 freeze thread trace"
    depends on (CPU_CORTEX_M3 || CPU_CORTEX_M4) && !SMP && !USERSPACE
    default y
    select THREAD_STACK_INFO
    help
      At the watchdog timeout, read the monitored thread's state, wait
      queue, saved stack pointer and at most six code addresses, scanning no
      more than 1024 bytes inside checked SRAM/stack bounds. Nothing runs
      ahead of the timeout and nothing is allocated or written to Flash.
      Stack words are return-address candidates, not a complete unwind.

config ZMK_WATCHDOG_FREEZE_TIMEOUT_MS
    int "Freeze detection timeout (ms)"
    default 10000
    range 10 600000
    help
      Keep this well above worst-case legitimate stalls (BLE connection
      storms, settings flash writes) but short enough that a real freeze is
      noticed quickly.

config ZMK_WATCHDOG_FREEZE_MONITOR_LOWPRIO_QUEUE
    bool "Also monitor ZMK's low-priority work queue"
    default y
    help
      The system work queue, where key events are processed, is always
      monitored. Disabling this saves one channel and its feed work, at the
      cost of missing a freeze of the low-priority queue alone.

endif # ZMK_WATCHDOG_FREEZE_DETECT

config ZMK_WATCHDOG_FATAL_DETECT
    bool "Detect hard faults (stack overflow, bus fault, oops/panic, ...)"
    default y
    help
      Overrides the weak k_sys_fatal_error_handler() to record a FATAL
      incident (reason, PC, LR, thread name) before rebooting, instead of
      Zephyr's default of halting forever. Another strong
      k_sys_fatal_error_handler in the application conflicts at link time;
      check which one the final ELF selected.

config ZMK_WATCHDOG_DIAGNOSTICS
    bool "Record bounded recent operations and build identity"
    default y
    depends on !SMP
    help
      Fixed RAM history with non-blocking writers and bounded fault snapshots:
      the last seven events, cached profile/USB/endpoint state and a build
      tag. A completed CRC-checked checkpoint can be recovered after a
      powered reset. No Flash writes in normal operation, no timers and no
      key material. RAM retention across a reset is not guaranteed.

config ZMK_WATCHDOG_BLE_DIAGNOSTICS
    bool "Trace public Bluetooth operations"
    default y if ZMK_BLE
    depends on ZMK_WATCHDOG_DIAGNOSTICS && ZMK_BLE
    help
      Passive connection callbacks and linker wrappers for bond clear,
      bt_unpair and bt_conn_disconnect, without changing their results or
      the connection policy. Calls within the defining object cannot be
      wrapped.

config ZMK_WATCHDOG_CAPTURE_CONTEXT
    bool "Capture common CPU context and owner operation records"
    default y
    depends on ZMK_WATCHDOG_DIAGNOSTICS && !SMP
    select THREAD_STACK_INFO
    select EXTRA_EXCEPTION_INFO if ARCH_HAS_EXTRA_EXCEPTION_INFO && (CPU_CORTEX_M3 || CPU_CORTEX_M4)
    help
      Preserve four bounded metadata operations with call sites and full-width
      arguments. Fatal and freeze records carry the same versioned extension.
      Cortex-M3/M4 adds checked callee registers, fault-address registers and
      bounded return-address candidates. Unsupported targets retain operations
      and explicitly mark unavailable CPU evidence. No periodic sampler or
      automatic fault injection is added.

config ZMK_WATCHDOG_ASSERT_CONTEXT
    bool "Record the call site and line of Zephyr assertions"
    default y
    depends on ZMK_WATCHDOG_CAPTURE_CONTEXT && ASSERT
    help
      Wrap the weak assertion post-action, recording metadata before forwarding
      its original action unchanged. Controller-specific assertions that bypass
      this hook still use ordinary fatal capture. Other strong overrides and
      calls within their defining object remain integration boundaries.

config ZMK_WATCHDOG_TEST_INJECTION
    bool "Enable dangerous test/fault injection helpers"
    help
      Adds helpers that deliberately freeze a monitored work queue or trigger
      a kernel oops, to validate the freeze/fatal detectors end to end. Never
      enable this in a production build. They are triggered by the Studio
      InjectTestRequest (central or non-split boards), or after a boot delay
      (split peripherals, which have no Studio RPC of their own).

if ZMK_WATCHDOG_TEST_INJECTION

config ZMK_WATCHDOG_TEST_INJECT_FREEZE_AT_BOOT_MS
    int "Auto-trigger a freeze this many ms after boot (0 = disabled)"
    default 0
    help
      Flash a test build with this set and power-cycle it to observe the
      freeze, reboot and recorded incident without any host tooling.

config ZMK_WATCHDOG_TEST_INJECT_FATAL_AT_BOOT_MS
    int "Auto-trigger a fatal error this many ms after boot (0 = disabled)"
    default 0
    help
      Same as CONFIG_ZMK_WATCHDOG_TEST_INJECT_FREEZE_AT_BOOT_MS with
      k_oops(). If both are set, whichever fires first reboots the device.

endif # ZMK_WATCHDOG_TEST_INJECTION

config ZMK_WATCHDOG_TEST
    bool "Enable watchdog self-test (native_sim only)"
    help
      Adds test-only init logic exercising the store and pending-slot boot
      conversion, and the test hooks it uses. Not for production builds.

config ZMK_WATCHDOG_STUDIO_RPC_TEST
    bool "Enable watchdog Studio RPC self-test (native_sim only)"
    depends on ZMK_WATCHDOG_STUDIO_RPC
    help
      Adds test-only init logic exercising the GetStatus/ListIncidents/
      DeleteIncidents handlers directly, without a transport. Separate from
      CONFIG_ZMK_WATCHDOG_TEST because ZMK_STUDIO needs a physical-layout
      devicetree. Not for production builds.

endif

config ZMK_WATCHDOG_FORK_LOG_LEVEL
    int "zmk-watchdog-fork log level (0 off, 1 error, 2 warning, 3 info, 4 debug)"
    range 0 4
    default 3
    help
      Logs contain operational state and numeric diagnostics, never input
      contents, user labels, peer addresses or authentication material.
```

## dts/bindings/kscan/amgskobo,watchdog-test-kscan.yaml
```yaml
# SPDX-License-Identifier: MIT
description: Watchdog owner native test input, not a physical keyboard driver
compatible: "amgskobo,watchdog-test-kscan"
include: base.yaml
properties:
  rows:
    type: int
    required: true
  columns:
    type: int
    required: true
  events:
    type: array
    required: true
  exit-after:
    type: boolean
```

## tests/trace/Kconfig
```kconfig
mainmenu "Watchdog trace kernel fixture"
config ZMK_WATCHDOG_FREEZE_TRACE
    bool
    default y
    select THREAD_STACK_INFO
source "Kconfig.zephyr"
config ZMK_WATCHDOG_DIAGNOSTICS
    bool
    default y
    select CRC
config ZMK_WATCHDOG_DIAGNOSTICS_TEST
    bool
    default y
config ZMK_WATCHDOG_CAPTURE_CONTEXT
    bool
    default y
    select EXTRA_EXCEPTION_INFO
```
